## arch/mips/trendchip/Kconfig
```kconfig
config TCSUPPORT_ACCOUNT_ACL
	bool "TCSUPPORT_ACCOUNT_ACL"

config TCSUPPORT_AUTOBENCH
	bool "TCSUPPORT_AUTOBENCH"

config TCSUPPORT_AUTOBENCH_AFE
	bool "TCSUPPORT_AUTOBENCH_AFE"

config TCSUPPORT_AUTO_PVC_TRIGGER
	bool "TCSUPPORT_AUTO_PVC_TRIGGER"

config TCSUPPORT_BTN_CHECK
	bool "TCSUPPORT_BTN_CHECK"

config TCSUPPORT_C1_NEW_GUI
	bool "TCSUPPORT_C1_NEW_GUI"

config TCSUPPORT_CD_NEW_GUI
	bool "TCSUPPORT_CD_NEW_GUI"

config TCSUPPORT_CHT_DSL_LED
	bool "TCSUPPORT_CHT_DSL_LED"

config TCSUPPORT_CT
	bool "TCSUPPORT_CT"

config TCSUPPORT_CT_DNSBIND
	bool "TCSUPPORT_CT_DNSBIND"

config TCSUPPORT_CWMP_VDSL
	bool "TCSUPPORT_CWMP_VDSL"

config TCSUPPORT_CZ_GENERAL
	bool "TCSUPPORT_CZ_GENERAL"

config TCSUPPORT_DOWNSTREAM_QOS
	bool "TCSUPPORT_DOWNSTREAM_QOS"

config TCSUPPORT_DSLITE
	bool "TCSUPPORT_DSLITE"

config TCSUPPORT_DUAL_IMAGE_ENHANCE
 	bool "TCSUPPORT_DUAL_IMAGE_ENHANCE"

config TCSUPPORT_DUAL_WLAN
	bool "TCSUPPORT_DUAL_WLAN"

config TCSUPPORT_E8B
	bool "TCSUPPORT_E8B"

config TCSUPPORT_FTP_THROUGHPUT
	bool "TCSUPPORT_FTP_THROUGHPUT"

config TCSUPPORT_HWNAT
	bool "TCSUPPORT_HWNAT"

config TCSUPPORT_HW_QOS
	bool "TCSUPPORT_HW_QOS"

config TCSUPPORT_IGMP_QOS
	bool "TCSUPPORT_IGMP_QOS"

config TCSUPPORT_IGMP_SNOOPING_V3
	bool "TCSUPPORT_IGMP_SNOOPING_V3"

config TCSUPPORT_IPV6_ADVANCE
	bool "TCSUPPORT_IPV6_ADVANCE"

config TCSUPPORT_IPV6_ENHANCEMENT
	bool "TCSUPPORT_IPV6_ENHANCEMENT"

config TCSUPPORT_IPV6_FIREWALL
	bool "TCSUPPORT_IPV6_FIREWALL"

config TCSUPPORT_LED_BTN_CHECK
	bool "TCSUPPORT_LED_BTN_CHECK"

config TCSUPPORT_LED_CHECK
	bool "TCSUPPORT_LED_CHECK"

config TCSUPPORT_LEDKEY
	bool "TCSUPPORT_LEDKEY"

config TCSUPPORT_MEMORY_CONTROL
	bool "TCSUPPORT_MEMORY_CONTROL"

config TCSUPPORT_SBTHROUGHPUT_ENHANCE
	bool "TCSUPPORT_SBTHROUGHPUT_ENHANCE"

config TCSUPPORT_SHARE_PVC
	bool "TCSUPPORT_SHARE_PVC"

config TCSUPPORT_SNMP_ATMADSL
	bool "TCSUPPORT_SNMP_ATMADSL"

config TCSUPPORT_SUPPORT_FLASH
	bool "TCSUPPORT_SUPPORT_FLASH"

config TCSUPPORT_TCP6_SYN_COOKIE
	bool "TCSUPPORT_TCP6_SYN_COOKIE"

config TCSUPPORT_TEST_LED_ALL
	bool "TCSUPPORT_TEST_LED_ALL"

config TCSUPPORT_TTNET
	bool "TCSUPPORT_TTNET"

config TCSUPPORT_USBHOST
	bool "TCSUPPORT_USBHOST"

config TCSUPPORT_VOIP
	bool "TCSUPPORT_VOIP"

config TCSUPPORT_WIFI_WPS_BTN_CO_USE
	bool "TCSUPPORT_WIFI_WPS_BTN_CO_USE"

config TCSUPPORT_WLAN
	bool "TCSUPPORT_WLAN"

config TCSUPPORT_WLAN_8021X
	bool "TCSUPPORT_WLAN_8021X"

config TCSUPPORT_WLAN_ATE
	bool "TCSUPPORT_WLAN_ATE"

config TCSUPPORT_WLAN_GPIO
	bool "TCSUPPORT_WLAN_GPIO"

config TCSUPPORT_WLAN_IGMPSNOOP
	bool "TCSUPPORT_WLAN_IGMPSNOOP"

config TCSUPPORT_WLAN_QATOOL
	bool "TCSUPPORT_WLAN_QATOOL"

config TCSUPPORT_WLAN_WDS
	bool "TCSUPPORT_WLAN_WDS"

config TCSUPPORT_WLAN_WPS
	bool "TCSUPPORT_WLAN_WPS"

config TCSUPPORT_XT_CONDITION
	bool "TCSUPPORT_XT_CONDITION"

config TCSUPPORT_XT_CONNLIMIT
	bool "TCSUPPORT_XT_CONNLIMIT"

config TCSUPPORT_XT_MATCH_DSCP
	bool "TCSUPPORT_XT_MATCH_DSCP"

config TCSUPPORT_RAETH_TSO
	bool "TCSUPPORT_RAETH_TSO"

config TCSUPPORT_DOUBLE_VLAN_TAG
	bool "TCSUPPORT_DOUBLE_VLAN_TAG"
```

## vendors/Kconfig
```kconfig
# Add new vendor config


source "vendors/Kconfig.ralink"

source "vendors/Kconfig.ndms"
```

## vendors/Kconfig.ndms
```kconfig
menu "NDM Systems options"

config RALINK_HWCRYPTO
	depends on MIPS_RT63365
	tristate "HW Crypto Engine support"
	default n

source "net/nat/hw_nat/Kconfig"

endmenu
```

## vendors/Kconfig.ralink
```kconfig
menu "Ralink Module"

#############
# Wireless
#############
menuconfig RT2860V2
	bool "RT2860v2 Wi-Fi Driver"

if RT2860V2
source "drivers/net/wireless/rt2860v2_ap/Kconfig"
endif

menuconfig RT539X_AP
	bool "RT539X PCI Wi-Fi Driver"
	select WIRELESS_EXT

if RT539X_AP
source "drivers/net/wireless/rt5392_ap/Kconfig"
endif

menuconfig RT359X_AP
	bool "RT359X PCI Wi-Fi Driver"
	select WIRELESS_EXT

if RT359X_AP
source "drivers/net/wireless/rt3592_ap/Kconfig"
endif

menuconfig RT559X_AP
	bool "RT559X PCI Wi-Fi Driver"
	select WIRELESS_EXT

if RT559X_AP
source "drivers/net/wireless/rt5592_ap/Kconfig"
endif

endmenu
```
